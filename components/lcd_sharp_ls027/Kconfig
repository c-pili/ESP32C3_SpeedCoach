## components/lcd_sharp_ls027/Kconfig
```kconfig
menu "Sharp LS027B7DH01 Memory LCD"

config LCD_SHARP_PIN_SCLK
    int "SCLK GPIO"
    range 0 21
    default 4

config LCD_SHARP_PIN_MOSI
    int "SI/MOSI GPIO"
    range 0 21
    default 5

config LCD_SHARP_PIN_SCS
    int "SCS GPIO (active high)"
    range 0 21
    default 10

config LCD_SHARP_PIN_DISP
    int "DISP GPIO"
    range 0 21
    default 3

config LCD_SHARP_SPI_CLOCK_HZ
    int "SPI clock (Hz; maximum 2 MHz)"
    range 100000 2000000
    default 2000000

endmenu
```

## components/lcd_st7789/Kconfig
```kconfig
menu "ST7789 LCD Configuration"

config LCD_ST7789_ENABLED
    bool "Enable ST7789 LCD"
    default y

config LCD_ST7789_HOST
    int "SPI Host (ESP32-C3: SPI2)"
    range 2 2
    default 2
    help
        ESP32-C3 exposes SPI2 as its general-purpose SPI host.

config LCD_ST7789_PIN_MOSI
    int "LCD MOSI GPIO"
    range 0 21
    default 5

config LCD_ST7789_PIN_SCLK
    int "LCD SCLK GPIO"
    range 0 21
    default 4

config LCD_ST7789_PIN_MISO
    int "LCD MISO GPIO (-1 if unused)"
    range -1 21
    default -1

config LCD_ST7789_PIN_DC
    int "LCD D/C GPIO"
    range 0 21
    default 3

config LCD_ST7789_PIN_CS
    int "LCD CS GPIO"
    range 0 21
    default 10

config LCD_ST7789_PIN_RST
    int "LCD RESET GPIO"
    range -1 21
    default -1

config LCD_ST7789_PIN_BL
    int "LCD Backlight GPIO"
    range -1 21
    default -1

config LCD_ST7789_PIXEL_CLOCK
    int "LCD SPI pixel clock (Hz)"
    default 20000000

endmenu
```

## components/mpu6050/Kconfig
```kconfig
menu "MPU6050 IMU Configuration"

config IMU_MPU6050_I2C_PORT
    int "MPU6050 I2C port number"
    default 0

config IMU_MPU6050_SDA
    int "MPU6050 SDA GPIO"
    default 0

config IMU_MPU6050_SCL
    int "MPU6050 SCL GPIO"
    default 1

config IMU_MPU6050_I2C_CLK
    int "MPU6050 I2C clock speed (Hz)"
    default 400000

config IMU_MPU6050_ADDR
    hex "MPU6050 7-bit I2C address"
    range 0x68 0x69
    default 0x68

endmenu
```
