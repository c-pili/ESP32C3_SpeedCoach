## components/lcd_sharp_ls027/Kconfig
```kconfig
menu "Sharp LS027B7DH01 Memory LCD"

config LCD_SHARP_PIN_SCLK
    int "SCLK GPIO"
    range 0 21
    default 4

config LCD_SHARP_PIN_MOSI
    int "SI/MOSI GPIO"
    range 0 21
    default 6

config LCD_SHARP_PIN_SCS
    int "SCS GPIO (active high)"
    range 0 21
    default 7

# DISP is hardwired to 3.3V on ESP32-C3 Super Mini; no GPIO needed.
# CONFIG_LCD_SHARP_PIN_DISP is not set

config LCD_SHARP_SPI_CLOCK_HZ
    int "SPI clock (Hz; maximum 2 MHz)"
    range 100000 2000000
    default 2000000

endmenu
```
